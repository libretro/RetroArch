## deps/libShake/extras/buildroot-package/libshake/Config.in
```kconfig
config BR2_PACKAGE_LIBSHAKE
	bool "libshake"
	help
	  A simple, cross-platform haptic library.

	  https://github.com/zear/libShake
```
